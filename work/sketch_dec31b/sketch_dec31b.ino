bool tmp[4][4] = {
  0, 0, 0, 0,
  0, 0, 0, 0, 
  0, 0, 0, 0, 
  0, 0, 0, 0, 
};


bool sss(int q = random(4)+1){
  bool eee[4][4] = {
    0, 0, 1, 0,
    0, 1, 1, 1, 
    0, 0, 1, 0, 
    0, 0, 1, 0, 
  };
  if(q==1){
    bool tmp[4][4];
    for(int i=0; i<4; i++){
      for(int j=0; j<4; j++){
        tmp[i][j] = eee[i][j];
      }
    }
  }
    if(q==2){
    bool tmp[4][4];
    for(int i=0; i<4; i++){
      for(int j=0; j<4; j++){
        tmp[i][j] = eee[4-i][j];
      }
    }
  }
    if(q==3){
    bool tmp[4][4];
    for(int i=0; i<4; i++){
      for(int j=0; j<4; j++){
        tmp[i][j] = eee[j][i];
      }
    }
  }
    if(q==4){
    bool tmp[4][4];
    for(int i=0; i<4; i++){
      for(int j=0; j<4; j++){
        tmp[i][j] = eee[j][4-i];
      }
    }
  }
}


/*#include<Wire.h>
#include<LiquidCrystal_I2C.h>
LiquidCrystal_I2C lcd(0x27,16,2);*/
int vrx = A1;
int vry = A2;
int sw = A3;
int DS = 2; //貨物DIN
int DT = 3; //出發CS
int SH = 4; //上貨CLK
void setup() {
  
  pinMode(DS, OUTPUT);
  pinMode(DT, OUTPUT);
  pinMode(SH, OUTPUT);
  /*lcd.init();
  lcd.backlight();
  lcd.setCursor(0,0);
  lcd.print("Suga: ");
  lcd.setCursor(5,1);
  lcd.print("Baekhyun: ");*/
  bool address[13][8] = { //初始設定
    {0, 0, 0, 0, 1, 1, 0, 0}, /*開啟顯示器模組*/
    {0, 0, 0, 0, 1, 0, 0, 1}, /*選用原始碼模式*/
    {0, 0, 0, 0, 1, 1, 1, 1}, /*關閉測試模式*/
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    {0, 0, 0, 0, 1, 0, 0, 0}
  };
  bool data[13][8] = { //初始設定
    {0, 0, 0, 0, 0, 0, 0, 1}, /*開啟顯示器模組*/
    {0, 0, 0, 0, 0, 0, 0, 0}, /*選用原始碼模式*/
    {0, 0, 0, 0, 0, 0, 0, 0}, /*關閉測試模式*/
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    {0, 0, 0, 0, 0, 0, 0, 0}
  };
  for (int i = 0; i < 13; i++) { //13行資料
    digitalWrite(DT, LOW);//貨車開門
    for (int j = 0; j < 4; j++) {
      for (int k = 0; k < 4; k++) {
        for (int l = 0; l < 8; l++) {
          digitalWrite(SH, LOW);//活塞收回
          digitalWrite(DS, address[i][l]);
          digitalWrite(SH, HIGH);//活塞推出
        }
        for (int l = 0; l < 8; l++) {
          digitalWrite(SH, LOW);//活塞收回
          digitalWrite(DS, data[i][l]);
          digitalWrite(SH, HIGH);//活塞推出
        }
      }
    }
    digitalWrite(DT, HIGH);//貨車出發
  }

}
bool table_address[8][8] = {
  {0, 0, 0, 0, 0, 0, 0, 1}, /*第1行地址*/
  {0, 0, 0, 0, 0, 0, 1, 0}, /*第2行地址*/
  {0, 0, 0, 0, 0, 0, 1, 1}, /*第3行地址*/
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  {0, 0, 0, 0, 1, 0, 0, 0} /*第8行地址*/
};

/*bool arrow[4][16] = {
  0, 0, 1, 0, 0, 1, 0, 0,  0, 0, 0, 0, 0, 0, 0, 0,
  0, 1, 1, 1, 0, 1, 0, 0,  0, 1, 0, 0, 0, 0, 1, 0,
  0, 0, 1, 0, 1, 1, 1, 0,  1, 1, 1, 1, 1, 1, 1, 1,
  0, 0, 1, 0, 0, 1, 0, 0,  0, 1, 0, 0, 0, 0, 1, 0,
};*/


bool table_data[32][32] = {
  0, 0, 0, 0, 0, 0, 0, 0,  0, 0, 0, 0, 0, 0, 0, 0,  0, 0, 0, 0, 0, 0, 0, 0,  0, 0, 0, 0, 0, 0, 0, 0,
  0, 0, 0, 0, 0, 0, 0, 0,  0, 0, 0, 0, 0, 0, 0, 0,  0, 0, 0, 0, 0, 0, 0, 0,  0, 0, 0, 0, 0, 0, 0, 0,
  0, 0, 0, 0, 0, 0, 0, 0,  0, 0, 0, 0, 0, 0, 0, 0,  0, 0, 0, 0, 0, 0, 0, 0,  0, 0, 0, 0, 0, 0, 0, 0,
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  0, 0, 0, 0, 0, 0, 0, 0,  0, 0, 0, 0, 0, 0, 0, 0,  0, 0, 0, 0, 0, 0, 0, 0,  0, 0, 0, 0, 0, 0, 0, 0,

};

int k = 5;
void loop() {

  max7219();
  k += 1;
  if (k > 4) {
    int Fx = 4 * random(2);
    bool Px= sss(); 
    for (int i = 0; i < 4; i++) {
      for (int j = 0; j < 4; j++) {
        table_data[i][j + 8 + Fx] = tmp[i][j];
      }
    }
    Fx = 4 * (random(2) + 2);
    sss();
    for (int i = 0; i < 4; i++) {
      for (int j = 0; j < 4; j++) {
        table_data[i][j + 8 + Fx] = tmp[i][j];
      }
    }
    k=0;
  }

  for (int i = 31; i >= 0; i--) {
    for (int j = 8; j <= 23; j++) {
      table_data[i + 1][j] = table_data[i][j];
    }

    /*for (int j = 12; j <= 14; j++) {
      table_data[i + 1][j] = table_data[i][j];
      }
      for (int j = 16; j <= 19; j++) {
      table_data[i + 1][j] = table_data[i][j];
      }

      for (int j = 20; j <= 23; j++) {
      table_data[i + 1][j] = table_data[i][j];
      }*/
  }

  for (int i = 9; i <= 23; i ++) table_data[0][i] = 0;
  //for(int i = 12;i <= 14;i ++) table_data[0][i] = 0;
  //for(int i = 16;i <= 19;i ++) table_data[0][i] = 0;
  //for(int i = 20;i <= 23;i ++) table_data[0][i] = 0;

  /*for(int i = 8; i<16; i++){
    for(int j=28; j<32; j++){
    if(table_data[i][j]==1)

    }
    }*/
read_way();
}

void read_way(){
    int x = analogRead(vrx);
    int y = analogRead(vry);
    for(int i = 8;i<16;i++){
      for(int j = 28;j<32;j++){
        if(table_data[i][j]==1){
          
        }
      }
    }
}

void max7219() {
  for (int i = 0; i < 8; i++) { //8行資料
    digitalWrite(DT, LOW);//貨車開門
    for (int j = 0; j < 4; j++) {
      for (int k = 0; k < 4; k++) {
        for (int l = 0; l < 8; l++) {
          digitalWrite(SH, LOW);//活塞收回
          digitalWrite(DS, table_address[i][l]);
          digitalWrite(SH, HIGH);//活塞推出
        }
        for (int l = 0; l < 8; l++) {
          digitalWrite(SH, LOW);//活塞收回
          digitalWrite(DS, table_data[i + j * 8][l + k * 8]);
          digitalWrite(SH, HIGH);//活塞推出
        }
      }
    }
    digitalWrite(DT, HIGH);//貨車出發
  }
  delay(80);
}
